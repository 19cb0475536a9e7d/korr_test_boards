## software/signal_board/port/korr_test_board/Kconfig
```kconfig
#
# For a description of the syntax of this configuration file,
# see the file kconfig-language.txt in the NuttX tools repository.
#

if ARCH_BOARD_KORR_TEST_SIGNAL_BOARD

config KORR_TEST_SIGNAL_BOARD_USER_LED_DEVICE
	bool "User LED device driver"
	default n
	---help---
		Enables creation of a /dev/led device

config KORR_TEST_SIGNAL_BOARD_USER_LED_DEVICE_NUMBER
	int "Index number of user leds in /dev/led"
	default 0
	depends on KORR_TEST_SIGNAL_BOARD_USER_LED_DEVICE
	---help---
		Specifies the index number of the user leds.
	
endif
```
